#include "lalapadmini.dtsi"

&kscan0 {
    col-gpios
        = <&xiao_d 4 GPIO_ACTIVE_HIGH>
        , <&xiao_d 5 GPIO_ACTIVE_HIGH>
        , <&xiao_d 6 GPIO_ACTIVE_HIGH>
        , <&gpio0  9 GPIO_ACTIVE_HIGH>
        , <&gpio0 10 GPIO_ACTIVE_HIGH>
        ;
};

&left_encoder {
    a-gpios = <&gpio1  0 (GPIO_ACTIVE_LOW | GPIO_PULL_UP)>;
    b-gpios = <&gpio0 16 (GPIO_ACTIVE_LOW | GPIO_PULL_UP)>;
    steps = <24>;
    status = "okay";
};

&glidepoint_split_L {
    status = "okay";
    device = <&glidepoint>;
};
&glidepoint_split_R {
    status = "disabled";
    device = <&glidepoint>;
};
