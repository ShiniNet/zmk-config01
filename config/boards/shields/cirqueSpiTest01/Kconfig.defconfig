## config/boards/shields/cirqueSpiTest01/Kconfig.defconfig
```kconfig
# Copyright (c) 2020 The ZMK Contributors
# SPDX-License-Identifier: MIT

if SHIELD_CIRQUESPITEST01_RIGHT

config ZMK_KEYBOARD_NAME
    default "cirquespitest01"

config ZMK_SPLIT_ROLE_CENTRAL
    default y

endif

if SHIELD_CIRQUESPITEST01_LEFT || SHIELD_CIRQUESPITEST01_RIGHT

config ZMK_SPLIT
    default y

endif
```

## config/boards/shields/cirqueSpiTest01/Kconfig.shield
```kconfig
# Copyright (c) 2020 The ZMK Contributors
# SPDX-License-Identifier: MIT

config SHIELD_CIRQUESPITEST01_LEFT
    def_bool $(shields_list_contains,cirquespitest01_left)

config SHIELD_CIRQUESPITEST01_RIGHT
    def_bool $(shields_list_contains,cirquespitest01_right)
```

## config/boards/shields/corne2/Kconfig.shield
```kconfig
# Copyright (c) 2020 Pete Johanson
# SPDX-License-Identifier: MIT

config SHIELD_CORNE2_LEFT
    def_bool $(shields_list_contains,corne2_left)

config SHIELD_CORNE2_RIGHT
    def_bool $(shields_list_contains,corne2_right)
```

## config/boards/shields/lalapad/Kconfig.defconfig
```kconfig
if SHIELD_LALAPAD_RIGHT

config ZMK_KEYBOARD_NAME
    default "Lalapad"

config ZMK_SPLIT_ROLE_CENTRAL
    default y

config ZMK_SPLIT_BLE_CENTRAL_PERIPHERALS
    default 1
    
config BT_MAX_CONN
    default 6

endif

if SHIELD_LALAPAD_LEFT || SHIELD_LALAPAD_RIGHT || SHIELD_LALAPAD_DONGLE

config ZMK_SPLIT
    default y

endif
```

## config/boards/shields/lalapad/Kconfig.shield
```kconfig
config SHIELD_LALAPAD_LEFT
    def_bool $(shields_list_contains,lalapad_left)

config SHIELD_LALAPAD_RIGHT
    def_bool $(shields_list_contains,lalapad_right)

config SHIELD_LALAPAD_DONGLE
    def_bool $(shields_list_contains,lalapad_dongle)
```

## config/boards/shields/lalapadgen2/Kconfig.defconfig
```kconfig
if SHIELD_LALAPADGEN2_RIGHT

config ZMK_KEYBOARD_NAME
    default "LalapadGen2"

config ZMK_SPLIT_ROLE_CENTRAL
    default y

config ZMK_SPLIT_BLE_CENTRAL_PERIPHERALS
    default 1
    
config BT_MAX_CONN
    default 5

endif

if SHIELD_LALAPADGEN2_LEFT || SHIELD_LALAPADGEN2_RIGHT

config ZMK_SPLIT
    default y

endif
```

## config/boards/shields/lalapadgen2/Kconfig.shield
```kconfig
config SHIELD_LALAPADGEN2_LEFT
    def_bool $(shields_list_contains,lalapadgen2_left)

config SHIELD_LALAPADGEN2_RIGHT
    def_bool $(shields_list_contains,lalapadgen2_right)
```

## config/boards/shields/lalapadmini/Kconfig.defconfig
```kconfig
if SHIELD_LALAPADMINI_RIGHT

config ZMK_KEYBOARD_NAME
    default "Lalapadmini"

config ZMK_SPLIT_ROLE_CENTRAL
    default y

config ZMK_SPLIT_BLE_CENTRAL_PERIPHERALS
    default 1
    
config BT_MAX_CONN
    default 5

endif

if SHIELD_LALAPADMINI_LEFT || SHIELD_LALAPADMINI_RIGHT

config ZMK_SPLIT
    default y

endif
```

## config/boards/shields/lalapadmini/Kconfig.shield
```kconfig
config SHIELD_LALAPADMINI_LEFT
    def_bool $(shields_list_contains,lalapadmini_left)

config SHIELD_LALAPADMINI_RIGHT
    def_bool $(shields_list_contains,lalapadmini_right)

config SHIELD_LALAPADMINI_DONGLE
    def_bool $(shields_list_contains,lalapadmini_dongle)
```

## config/boards/shields/lalapadv2/Kconfig.defconfig
```kconfig
if SHIELD_LALAPADV2_RIGHT


config ZMK_SPLIT_ROLE_CENTRAL
    default y

config ZMK_SPLIT_BLE_CENTRAL_PERIPHERALS
    default 1
    
config BT_MAX_CONN
    default 1

endif

if SHIELD_LALAPADV2_LEFT || SHIELD_LALAPADV2_RIGHT

config ZMK_KEYBOARD_NAME
    default "Lalapadv2"
    
config ZMK_SPLIT
    default y

endif
```

## config/boards/shields/lalapadv2/Kconfig.shield
```kconfig
config SHIELD_LALAPADV2_LEFT
    def_bool $(shields_list_contains,lalapadv2_left)

config SHIELD_LALAPADV2_RIGHT
    def_bool $(shields_list_contains,lalapadv2_right)
```

## config/boards/shields/shiniboard01/Kconfig.defconfig
```kconfig
# Copyright (c) 2020 The ZMK Contributors
# SPDX-License-Identifier: MIT

if SHIELD_SHINIBOARD01_LEFT

config ZMK_KEYBOARD_NAME
    default "SHINIBOARD01"

config ZMK_SPLIT_ROLE_CENTRAL
    default y

endif

if SHIELD_SHINIBOARD01_LEFT || SHIELD_SHINIBOARD01_RIGHT

config ZMK_SPLIT
    default y

endif

config I2C
    default y
```

## config/boards/shields/shiniboard01/Kconfig.shield
```kconfig
# Copyright (c) 2020 The ZMK Contributors
# SPDX-License-Identifier: MIT

config SHIELD_SHINIBOARD01_LEFT
    def_bool $(shields_list_contains,shiniboard01_left)

config SHIELD_SHINIBOARD01_RIGHT
    def_bool $(shields_list_contains,shiniboard01_right)
```

## config/west.yml
```yaml
# manifest:
#   remotes:
#     - name: zmkfirmware
#       url-base: https://github.com/zmkfirmware
#     # Additional modules containing boards/shields/custom code can be listed here as well
#     # See https://docs.zephyrproject.org/3.2.0/develop/west/manifest.html#projects
#   projects:
#     - name: zmk
#       remote: zmkfirmware
#       revision: main
#       import: app/west.yml
#   self:
#     path: config
manifest:
  remotes:
    - name: zmkfirmware
      url-base: https://github.com/zmkfirmware
    - name: ShiniNet
      url-base: https://github.com/ShiniNet/
    - name: caksoylar 
      url-base: https://github.com/caksoylar  
    - name: carrefinho                            # <--- add this
      url-base: https://github.com/carrefinho     # <--- and this
  projects:
    - name: zmk
      remote: zmkfirmware
      revision: v0.2.1
      import: app/west.yml
    - name: cirque-input-module
      remote: ShiniNet
      revision: main
    - name: zmk-rgbled-widget
      remote: caksoylar
      revision: main
    - name: prospector-zmk-module                 # <--- and these
      remote: carrefinho                          # <---
      revision: main                              # <---
  self:
    path: config
```
