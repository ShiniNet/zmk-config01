/*
 * Copyright (c) 2020 The ZMK Contributors
 *
 * SPDX-License-Identifier: MIT
 */

#include "shiniboard01.dtsi"

&kscan0 {
    col-gpios
        = <&gpio0 4 GPIO_ACTIVE_HIGH>
        , <&gpio0 5 GPIO_ACTIVE_HIGH>
        , <&gpio0 6 GPIO_ACTIVE_HIGH>
        , <&gpio0 7 GPIO_ACTIVE_HIGH>
        , <&gpio0 8 GPIO_ACTIVE_HIGH>
        , <&gpio0 9 GPIO_ACTIVE_HIGH>
        ;
};
