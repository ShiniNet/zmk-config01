#include "lalapadgen2.dtsi"

&kscan0 {
    col-gpios
        = <&gpio0 19 GPIO_ACTIVE_HIGH>
        , <&gpio0 15 GPIO_ACTIVE_HIGH>
        , <&xiao_d 3 GPIO_ACTIVE_HIGH>
        , <&xiao_d 2 GPIO_ACTIVE_HIGH>
        , <&xiao_d 1 GPIO_ACTIVE_HIGH>
        , <&xiao_d 0 GPIO_ACTIVE_HIGH>
        ;
};

&trackpad_split_L {
    status = "okay";
    device = <&iqs9151>;
};
&trackpad_split_R {
    status = "disabled";
    device = <&iqs9151>;
};
